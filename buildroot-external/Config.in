## buildroot-external/board/jethome/jethub-j100/rescue.its
```
/dts-v1/;

/ {
	description = "JetHub j100 recovery image";
	#address-cells = <1>;

	images {
		kernel {
			description = "Linux kernel";
			data = /incbin/("Image");
			type = "kernel";
			arch = "arm64";
			os = "linux";
			compression = "none";
			load = <0x14000000>;
			entry = <0x14000000>;
		};

		fdt {
			description = "Device tree";
			data = /incbin/("meson-axg-jethome-jethub-j100.dtb");
			type = "flat_dt";
			arch = "arm64";
			compression = "none";
			load = <0x10800000>;
		};

		ramdisk {
			description = "Root filesystem";
			data = /incbin/("rootfs.cpio.zst");
			type = "ramdisk";
			arch = "arm64";
			os = "linux";
			compression = "none";
		};
	};

	configurations {
		default = "recovery";

		recovery {
			description = "Recovery system";
			kernel = "kernel";
			fdt = "fdt";
			ramdisk = "ramdisk";
		};
	};
};
```

## buildroot-external/board/jethome/jethub-j300/rescue.its
```
/dts-v1/;

/ {
	description = "JetHub J300 recovery image";
	#address-cells = <1>;

	images {
		kernel {
			description = "Linux kernel";
			data = /incbin/("Image");
			type = "kernel";
			arch = "arm64";
			os = "linux";
			compression = "none";
			load = <0x14000000>;
			entry = <0x14000000>;
		};

		fdt {
			description = "Device tree";
			data = /incbin/("meson-s7d-jethub-j300.dtb");
			type = "flat_dt";
			arch = "arm64";
			compression = "none";
			load = <0x10800000>;
		};

		ramdisk {
			description = "Root filesystem";
			data = /incbin/("rootfs.cpio.lzma");
			type = "ramdisk";
			arch = "arm64";
			os = "linux";
			compression = "lzma";
			load = <0x1A000000>;
		};
	};

	configurations {
		default = "recovery";

		recovery {
			description = "Recovery system";
			kernel = "kernel";
			fdt = "fdt";
			ramdisk = "ramdisk";
		};
	};
};
```

## buildroot-external/board/jethome/jethub-j310/rescue.its
```
/dts-v1/;

/ {
	description = "JetHub j310 recovery image";
	#address-cells = <1>;

	images {
		kernel {
			description = "Linux kernel";
			data = /incbin/("Image");
			type = "kernel";
			arch = "arm64";
			os = "linux";
			compression = "none";
			load = <0x14000000>;
			entry = <0x14000000>;
		};

		fdt {
			description = "Device tree";
			data = /incbin/("meson-s7-jethub-j310.dtb");
			type = "flat_dt";
			arch = "arm64";
			compression = "none";
			load = <0x10800000>;
		};

		ramdisk {
			description = "Root filesystem";
			data = /incbin/("rootfs.cpio.zst");
			type = "ramdisk";
			arch = "arm64";
			os = "linux";
			compression = "none";
		};
	};

	configurations {
		default = "recovery";

		recovery {
			description = "Recovery system";
			kernel = "kernel";
			fdt = "fdt";
			ramdisk = "ramdisk";
		};
	};
};
```

## buildroot-external/configs/jethub_j100_defconfig
```kconfig
# BR2_PACKAGE_IFUPDOWN_SCRIPTS is not set
# BR2_PACKAGE_LVM2_STANDARD_INSTALL is not set
# BR2_PACKAGE_NFS_UTILS_RPC_NFSD is not set
# BR2_PACKAGE_SYSTEMD_HWDB is not set
# BR2_PACKAGE_SYSTEMD_NETWORKD is not set
# BR2_TARGET_GENERIC_REMOUNT_ROOTFS_RW is not set
# BR2_TARGET_ROOTFS_TAR is not set
BR2_PACKAGE_RAUC=y
BR2_PACKAGE_RAUC_DBUS=y
BR2_PACKAGE_RAUC_NETWORK=y
BR2_PACKAGE_SYSTEMD=y
BR2_CCACHE=y
BR2_CCACHE_DIR="/cache/cc"
BR2_DL_DIR="/cache/dl"
BR2_ENABLE_LTO=y
BR2_TOOLCHAIN_BUILDROOT_CXX=y
# BR2_GLOBAL_PATCH_DIR is not set
BR2_INIT_SYSTEMD=y
BR2_LINUX_KERNEL=y
BR2_LINUX_KERNEL_CUSTOM_VERSION=y
BR2_LINUX_KERNEL_CUSTOM_VERSION_VALUE="6.18.35"
BR2_PACKAGE_HOST_LINUX_HEADERS_CUSTOM_6_18=y
BR2_LINUX_KERNEL_USE_CUSTOM_CONFIG=y
BR2_LINUX_KERNEL_CUSTOM_CONFIG_FILE="$(BR2_EXTERNAL_JHOS_PATH)/board/jethome/kernel-mainline.config"
BR2_LINUX_KERNEL_CONFIG_FRAGMENT_FILES="$(BR2_EXTERNAL_JHOS_PATH)/board/jethome/jethub-j100/kernel-recovery.config"
BR2_LINUX_KERNEL_DTS_SUPPORT=y
BR2_LINUX_KERNEL_INTREE_DTS_NAME="amlogic/meson-axg-jethome-jethub-j100"
BR2_LINUX_KERNEL_NEEDS_HOST_LIBELF=y
BR2_LINUX_KERNEL_NEEDS_HOST_OPENSSL=y
BR2_PACKAGE_BASH=y
BR2_PACKAGE_BUSYBOX=y
BR2_PACKAGE_BUSYBOX_CONFIG="$(BR2_EXTERNAL_JHOS_PATH)/busybox.config"
BR2_PACKAGE_BUSYBOX_INDIVIDUAL_BINARIES=y
BR2_PACKAGE_BUSYBOX_SHOW_OTHERS=y
BR2_PACKAGE_CA_CERTIFICATES=y
BR2_PACKAGE_HOST_KMOD_XZ=y
BR2_PACKAGE_HOST_RAUC=y
BR2_PACKAGE_HOST_UBOOT_TOOLS=y
BR2_PACKAGE_HOST_UBOOT_TOOLS_FIT_SUPPORT=y
BR2_PACKAGE_UBOOT_TOOLS=y
BR2_PACKAGE_UBOOT_TOOLS_FWPRINTENV=y
BR2_PACKAGE_ARMBIAN_FIRMWARE=y
BR2_PACKAGE_ARMBIAN_FIRMWARE_AP6255=y
BR2_PACKAGE_ARMBIAN_FIRMWARE_AP6256=y
BR2_PACKAGE_LINUX_FIRMWARE=y
BR2_PACKAGE_LINUX_FIRMWARE_RTL_RTW88=y
BR2_PACKAGE_WIRELESS_REGDB=y
BR2_PACKAGE_IW=y
BR2_PACKAGE_WPA_SUPPLICANT=y
BR2_PACKAGE_WPA_SUPPLICANT_NL80211=y
BR2_PACKAGE_WPA_SUPPLICANT_WPA3=y
BR2_PACKAGE_WPA_SUPPLICANT_CLI=y
BR2_PACKAGE_WPA_SUPPLICANT_PASSPHRASE=y
BR2_PACKAGE_WPA_SUPPLICANT_DBUS=y
BR2_PACKAGE_WPA_SUPPLICANT_AP_SUPPORT=y
BR2_PACKAGE_NETWORK_MANAGER=y
BR2_PACKAGE_NETWORK_MANAGER_CLI=y
BR2_PACKAGE_DNSMASQ=y
BR2_ROOTFS_OVERLAY="$(BR2_EXTERNAL_JHOS_PATH)/rootfs-overlay $(BR2_EXTERNAL_JHOS_PATH)/board/jethome/jethub-j100/rootfs-overlay"
BR2_ROOTFS_POST_BUILD_SCRIPT="$(BR2_EXTERNAL_JHOS_PATH)/scripts/post-build.sh"
BR2_ROOTFS_POST_IMAGE_SCRIPT="$(BR2_EXTERNAL_JHOS_PATH)/scripts/post-image.sh"
BR2_ROOTFS_POST_SCRIPT_ARGS="$(BR2_EXTERNAL_JHOS_PATH)/board/jethome/jethub-j100 $(BR2_EXTERNAL_JHOS_PATH)/board/jethome/jethub-j100/os-hook.sh"
BR2_SSP_REGULAR=y
BR2_SYSTEM_BIN_SH_BASH=y
BR2_TARGET_GENERIC_HOSTNAME="jethub-j100"
BR2_TARGET_GENERIC_ISSUE="Welcome to JetHub"
BR2_TARGET_ROOTFS_CPIO=y
BR2_TARGET_ROOTFS_CPIO_LZMA=y
BR2_TARGET_UBOOT=y
BR2_TARGET_UBOOT_BUILD_SYSTEM_KCONFIG=y
BR2_TARGET_UBOOT_CUSTOM_VERSION=y
BR2_TARGET_UBOOT_CUSTOM_VERSION_VALUE="2026.04"
BR2_TARGET_UBOOT_PATCH="$(BR2_EXTERNAL_JHOS_PATH)/board/jethome/jethub-j100/patches/uboot"
BR2_TARGET_UBOOT_BOARD_DEFCONFIG="jethub_j100"
BR2_TARGET_UBOOT_CONFIG_FRAGMENT_FILES="$(BR2_EXTERNAL_JHOS_PATH)/board/jethome/jethub-j100/uboot.config"
BR2_TARGET_UBOOT_NEEDS_OPENSSL=y
BR2_PACKAGE_AMLOGIC_BOOT_FIP_E=y
BR2_PACKAGE_AMLOGIC_BOOT_FIP_E_BOARD="jethub-j100"
BR2_aarch64=y
# BR2_PACKAGE_LINUX_PAM is not set
BR2_PACKAGE_LIBXCRYPT=y
BR2_PER_PACKAGE_DIRECTORIES=y
BR2_GNU_MIRROR="https://mirror.truenetwork.ru/gnu/"
BR2_PACKAGE_UTIL_LINUX=y
BR2_PACKAGE_UTIL_LINUX_BINARIES=y
BR2_PACKAGE_UTIL_LINUX_LOSETUP=y
# jrescue-app selects its own runtime deps (python3+curses/ssl/xz/zlib,
# Pillow+freetype+dejavu, evdev, ncurses, pv) via package/jrescue-app/Config.in
BR2_PACKAGE_JRESCUE_APP=y
BR2_ENABLE_LOCALE=y
BR2_GENERATE_LOCALE="C.UTF-8 ru_RU.UTF-8"
```

## buildroot-external/configs/jethub_j300_defconfig
```kconfig
# BR2_PACKAGE_IFUPDOWN_SCRIPTS is not set
# BR2_PACKAGE_LVM2_STANDARD_INSTALL is not set
# BR2_PACKAGE_NFS_UTILS_RPC_NFSD is not set
# BR2_PACKAGE_SYSTEMD_HWDB is not set
BR2_PACKAGE_SYSTEMD_NETWORKD=y
# BR2_TARGET_GENERIC_REMOUNT_ROOTFS_RW is not set
# BR2_TARGET_ROOTFS_TAR is not set
BR2_PACKAGE_RAUC_DBUS=y
BR2_PACKAGE_RTL8822CS_NEW=y
BR2_PACKAGE_SYSTEMD=y
BR2_CCACHE_DIR="/cache/cc"
BR2_DL_DIR="/cache/dl"
BR2_ENABLE_LTO=y
# BR2_GLOBAL_PATCH_DIR is not set
BR2_INIT_SYSTEMD=y
BR2_LINUX_KERNEL=y
BR2_LINUX_KERNEL_CUSTOM_GIT=y
BR2_LINUX_KERNEL_CUSTOM_REPO_URL="https://github.com/jethome-iot/linux-kernel.git"
BR2_LINUX_KERNEL_CUSTOM_REPO_VERSION="linux-s7d-5.15"
BR2_LINUX_KERNEL_USE_DEFCONFIG=y
BR2_LINUX_KERNEL_DEFCONFIG="jethub_j300"
BR2_KERNEL_HEADERS_5_15=y
BR2_LINUX_KERNEL_IMAGE_TARGET_CUSTOM=y
BR2_LINUX_KERNEL_IMAGE_TARGET_NAME="Image meson-s7d-jethub-j300.dtb"
BR2_LINUX_KERNEL_IMAGE_NAME="Image"
BR2_LINUX_KERNEL_NEEDS_HOST_LIBELF=y
BR2_LINUX_KERNEL_NEEDS_HOST_OPENSSL=y
BR2_PACKAGE_UBOOT_J300_PREBUILT=y
BR2_PACKAGE_BASH=y
BR2_PACKAGE_BUSYBOX=y
BR2_PACKAGE_BUSYBOX_CONFIG="$(BR2_EXTERNAL_JHOS_PATH)/busybox.config"
BR2_PACKAGE_BUSYBOX_INDIVIDUAL_BINARIES=y
BR2_PACKAGE_BUSYBOX_SHOW_OTHERS=y
BR2_PACKAGE_CA_CERTIFICATES=y
BR2_PACKAGE_HOST_DOSFSTOOLS=y
BR2_PACKAGE_HOST_E2FSPROGS=y
BR2_PACKAGE_HOST_GENIMAGE=y
BR2_PACKAGE_HOST_GPTFDISK=y
BR2_PACKAGE_HOST_KMOD_XZ=y
BR2_PACKAGE_HOST_MTOOLS=y
BR2_PACKAGE_HOST_RAUC=y
BR2_PACKAGE_HOST_TEMPIO=y
BR2_PACKAGE_HOST_UBOOT_TOOLS=y
BR2_PACKAGE_UBOOT_TOOLS=y
BR2_PACKAGE_UBOOT_TOOLS_FWPRINTENV=y
BR2_PACKAGE_LINUX_FIRMWARE=y
BR2_PACKAGE_WIRELESS_REGDB=y
BR2_PACKAGE_WPA_SUPPLICANT=y
BR2_PACKAGE_WPA_SUPPLICANT_AP_SUPPORT=y
BR2_PACKAGE_WPA_SUPPLICANT_WEXT=y
BR2_PACKAGE_WPA_SUPPLICANT_WPA3=y
BR2_PACKAGE_WPA_SUPPLICANT_CLI=y
BR2_ROOTFS_OVERLAY="$(BR2_EXTERNAL_JHOS_PATH)/board/jethome/jethub-j300/rootfs-overlay"
BR2_ROOTFS_POST_BUILD_SCRIPT="$(BR2_EXTERNAL_JHOS_PATH)/scripts/post-build.sh"
BR2_ROOTFS_POST_IMAGE_SCRIPT="$(BR2_EXTERNAL_JHOS_PATH)/scripts/post-image.sh"
BR2_ROOTFS_POST_SCRIPT_ARGS="$(BR2_EXTERNAL_JHOS_PATH)/board/jethome/jethub-j300 $(BR2_EXTERNAL_JHOS_PATH)/board/jethome/jethub-j300/os-hook.sh"
BR2_SSP_REGULAR=y
BR2_SYSTEM_BIN_SH_BASH=y
BR2_TARGET_GENERIC_HOSTNAME="jethubj300"
BR2_TARGET_GENERIC_ISSUE="Welcome to JetHub"
BR2_TARGET_ROOTFS_EROFS=y
BR2_TARGET_ROOTFS_EROFS_DEDUPE=y
BR2_TARGET_ROOTFS_EROFS_FRAGMENTS=y
BR2_TARGET_ROOTFS_EROFS_LZMA=y
BR2_TARGET_ROOTFS_EROFS_LZMA_LEVEL=109
BR2_TARGET_ROOTFS_EROFS_PCLUSTERSIZE=262144
BR2_TARGET_ROOTFS_EROFS_ZTAILPACKING=y
# BR2_TARGET_UBOOT is not set
BR2_aarch64=y
# BR2_PACKAGE_LINUX_PAM is not set
BR2_PACKAGE_LIBXCRYPT=y
BR2_PACKAGE_PYTHON3=y
BR2_PER_PACKAGE_DIRECTORIES=y
BR2_GNU_MIRROR=https://mirror.truenetwork.ru/gnu/
BR2_PACKAGE_PYTHON_PILLOW=y
BR2_PACKAGE_FREETYPE=y
BR2_PACKAGE_DEJAVU=y
BR2_PACKAGE_PYTHON_EVDEV=y
BR2_PACKAGE_OPENSSL=y
BR2_PACKAGE_PYTHON3_XZ=y
BR2_PACKAGE_PYTHON3_ZLIB=y
BR2_PACKAGE_PV=y
BR2_PACKAGE_JRESCUE_APP=y
BR2_PACKAGE_PYTHON3_SSL=y
BR2_PACKAGE_NCURSES=y
BR2_ENABLE_LOCALE=y
BR2_GENERATE_LOCALE="C.UTF-8 ru_RU.UTF-8"
BR2_PACKAGE_NCURSES_WCHAR=y
```

## buildroot-external/configs/jethub_j310_defconfig
```kconfig
# BR2_PACKAGE_IFUPDOWN_SCRIPTS is not set
# BR2_PACKAGE_LVM2_STANDARD_INSTALL is not set
# BR2_PACKAGE_NFS_UTILS_RPC_NFSD is not set
# BR2_PACKAGE_SYSTEMD_HWDB is not set
BR2_PACKAGE_SYSTEMD_NETWORKD=y
# BR2_TARGET_GENERIC_REMOUNT_ROOTFS_RW is not set
# BR2_TARGET_ROOTFS_TAR is not set
BR2_PACKAGE_RAUC=y
BR2_PACKAGE_RAUC_DBUS=y
BR2_PACKAGE_RAUC_NETWORK=y
BR2_PACKAGE_SYSTEMD=y
BR2_CCACHE=y
BR2_CCACHE_DIR="/cache/cc"
BR2_DL_DIR="/cache/dl"
BR2_ENABLE_LTO=y
BR2_TOOLCHAIN_BUILDROOT_CXX=y
# BR2_GLOBAL_PATCH_DIR is not set
BR2_INIT_SYSTEMD=y
BR2_LINUX_KERNEL=y
BR2_LINUX_KERNEL_CUSTOM_GIT=y
BR2_LINUX_KERNEL_CUSTOM_REPO_URL="https://github.com/jethome-iot/linux-kernel.git"
BR2_LINUX_KERNEL_CUSTOM_REPO_VERSION="linux-s7-5.15"
BR2_LINUX_KERNEL_USE_CUSTOM_CONFIG=y
BR2_LINUX_KERNEL_CUSTOM_CONFIG_FILE="$(BR2_EXTERNAL_JHOS_PATH)/board/jethome/kernel-amlogic.config"
BR2_KERNEL_HEADERS_5_15=y
BR2_LINUX_KERNEL_IMAGE_TARGET_CUSTOM=y
BR2_LINUX_KERNEL_IMAGE_TARGET_NAME="Image meson-s7-jethub-j310.dtb"
BR2_LINUX_KERNEL_IMAGE_NAME="Image"
BR2_LINUX_KERNEL_NEEDS_HOST_LIBELF=y
BR2_LINUX_KERNEL_NEEDS_HOST_OPENSSL=y
BR2_PACKAGE_BASH=y
BR2_PACKAGE_BUSYBOX=y
BR2_PACKAGE_BUSYBOX_CONFIG="$(BR2_EXTERNAL_JHOS_PATH)/busybox.config"
BR2_PACKAGE_BUSYBOX_INDIVIDUAL_BINARIES=y
BR2_PACKAGE_BUSYBOX_SHOW_OTHERS=y
BR2_PACKAGE_CA_CERTIFICATES=y
BR2_PACKAGE_HOST_KMOD_XZ=y
BR2_PACKAGE_HOST_RAUC=y
BR2_PACKAGE_HOST_UBOOT_TOOLS=y
BR2_PACKAGE_HOST_UBOOT_TOOLS_FIT_SUPPORT=y
BR2_PACKAGE_UBOOT_TOOLS=y
BR2_PACKAGE_UBOOT_TOOLS_FWPRINTENV=y
BR2_PACKAGE_LINUX_FIRMWARE=y
BR2_PACKAGE_LINUX_FIRMWARE_RTL_88XX_BT=y
BR2_PACKAGE_WIRELESS_REGDB=y
# BR2_PACKAGE_WPA_SUPPLICANT is not set
BR2_ROOTFS_OVERLAY="$(BR2_EXTERNAL_JHOS_PATH)/rootfs-overlay $(BR2_EXTERNAL_JHOS_PATH)/board/jethome/jethub-j310/rootfs-overlay"
BR2_ROOTFS_POST_BUILD_SCRIPT="$(BR2_EXTERNAL_JHOS_PATH)/scripts/post-build.sh"
BR2_ROOTFS_POST_IMAGE_SCRIPT="$(BR2_EXTERNAL_JHOS_PATH)/scripts/post-image.sh"
BR2_ROOTFS_POST_SCRIPT_ARGS="$(BR2_EXTERNAL_JHOS_PATH)/board/jethome/jethub-j310 $(BR2_EXTERNAL_JHOS_PATH)/board/jethome/jethub-j310/os-hook.sh"
BR2_SSP_REGULAR=y
BR2_SYSTEM_BIN_SH_BASH=y
BR2_TARGET_GENERIC_HOSTNAME="jethubj310"
BR2_TARGET_GENERIC_ISSUE="Welcome to JetHub"
BR2_TARGET_ROOTFS_CPIO=y
BR2_TARGET_ROOTFS_CPIO_LZMA=y
# BR2_TARGET_UBOOT is not set
BR2_aarch64=y
# BR2_PACKAGE_LINUX_PAM is not set
BR2_PACKAGE_LIBXCRYPT=y
BR2_PER_PACKAGE_DIRECTORIES=y
BR2_GNU_MIRROR="https://mirror.truenetwork.ru/gnu/"
BR2_PACKAGE_UTIL_LINUX=y
BR2_PACKAGE_UTIL_LINUX_BINARIES=y
BR2_PACKAGE_UTIL_LINUX_LOSETUP=y
# jrescue-app selects its own runtime deps (python3+curses/ssl/xz/zlib,
# Pillow+freetype+dejavu, evdev, ncurses, pv) via package/jrescue-app/Config.in
BR2_PACKAGE_JRESCUE_APP=y
BR2_ENABLE_LOCALE=y
BR2_GENERATE_LOCALE="C.UTF-8 ru_RU.UTF-8"
```

## buildroot-external/package/jrescue-app/Config.in
```kconfig
config BR2_PACKAGE_JRESCUE_APP
	bool "jrescue-app"
	depends on BR2_USE_WCHAR
	depends on BR2_USE_MMU
	depends on BR2_TOOLCHAIN_HAS_THREADS
	depends on !BR2_STATIC_LIBS
	depends on BR2_INSTALL_LIBSTDCPP
	depends on BR2_TOOLCHAIN_HEADERS_AT_LEAST_4_4
	select BR2_PACKAGE_PYTHON3
	select BR2_PACKAGE_PYTHON3_CURSES
	select BR2_PACKAGE_NCURSES
	select BR2_PACKAGE_NCURSES_WCHAR
	select BR2_PACKAGE_PYTHON3_SSL
	select BR2_PACKAGE_PYTHON3_XZ
	select BR2_PACKAGE_PYTHON3_ZLIB
	select BR2_PACKAGE_PV
	select BR2_PACKAGE_PYTHON_PILLOW
	select BR2_PACKAGE_FREETYPE
	select BR2_PACKAGE_DEJAVU
	select BR2_PACKAGE_PYTHON_EVDEV
	select BR2_PACKAGE_HOSTAPD
	select BR2_PACKAGE_HOSTAPD_DRIVER_NL80211
	select BR2_PACKAGE_DNSMASQ
	select BR2_PACKAGE_IW
	select BR2_PACKAGE_UTIL_LINUX_RFKILL
	select BR2_PACKAGE_AVAHI
	select BR2_PACKAGE_AVAHI_DAEMON
	help
	  JetHome rescue application: console, OLED, and web
	  interfaces for eMMC firmware flashing on JetHub devices.

	  Networking is driven through NetworkManager (nmcli), which
	  is a system-level choice and is NOT selected here — enable
	  BR2_PACKAGE_NETWORK_MANAGER(_CLI) in the defconfig.

	  https://github.com/jethome-iot/jrescue-app

comment "jrescue-app needs a toolchain w/ wchar, threads, C++, dynamic library, headers >= 4.4"
	depends on BR2_USE_MMU
	depends on !BR2_USE_WCHAR || !BR2_TOOLCHAIN_HAS_THREADS || \
		BR2_STATIC_LIBS || !BR2_INSTALL_LIBSTDCPP || \
		!BR2_TOOLCHAIN_HEADERS_AT_LEAST_4_4
```

## buildroot-external/package/uboot-j300-prebuilt/Config.in
```kconfig
config BR2_PACKAGE_UBOOT_J300_PREBUILT
	bool "uboot-j300-prebuilt"
	help
	  Pre-built U-Boot binary for JetHub J300.

	  This package installs a pre-compiled u-boot.bin
	  instead of building U-Boot from source.
```

## buildroot-external/package/uboot-j300y5-prebuilt/Config.in
```kconfig
config BR2_PACKAGE_UBOOT_J300Y5_PREBUILT
	bool "uboot-j300y5-prebuilt"
	help
	  Pre-built U-Boot binary for JetHub J300Y5 (Amlogic S905Y5 / S7).

	  This package installs a pre-compiled u-boot.bin
	  instead of building U-Boot from source.
```

## buildroot-external/package/uboot-j310-prebuilt/Config.in
```kconfig
config BR2_PACKAGE_UBOOT_j310_PREBUILT
	bool "uboot-j310-prebuilt"
	help
	  Pre-built U-Boot binary for JetHub j310 (Amlogic S905Y5 / S7).

	  This package installs a pre-compiled u-boot.bin
	  instead of building U-Boot from source.
```
